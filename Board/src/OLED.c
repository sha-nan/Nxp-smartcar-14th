/*********************************************************
------------------------------------------------
使用说明：SD卡核心板专用程序
OLED电源使用3.3V。
----------------
G    电源地
3.3V 接3.3V电源
CS   已接地，不用接
*********************************************************/
#include "common.h"
#include "MK60_gpio.h"
#include "MK60_port.h"
#include  "OLED.h"


#define XLevelL		0x00
#define XLevelH		0x10
#define XLevel		((XLevelH&0x0F)*16+XLevelL)
#define Max_Column	128
#define Max_Row		  64
#define	Brightness	0xCF

/*
4线SPI使用说明：
VBT 供内部DC-DC电压，3.3~4.3V，如果使用5V电压，为保险起见串一个100~500欧的电阻
VCC 供内部逻辑电压 1.8~6V
GND 地

BS0 低电平
BS1 低电平
BS2 低电平

CS  片选管脚
DC  命令数据选择管脚
RES 模块复位管脚
D0（SCLK） ，时钟脚，由MCU控制
D1（MOSI） ，主输出从输入数据脚，由MCU控制

D2 悬空
D3-D7 ， 低电平 ， 也可悬空，但最好设为低电平
RD  低电平 ，也可悬空，但最好设为低电平
RW  低电平 ，也可悬空，但最好设为低电平
RD  低电平 ，也可悬空，但最好设为低电平
*/

#define X_WIDTH 128
#define Y_WIDTH 64
//======================================
const byte F6x8[][6] =
{
    { 0x00, 0x00, 0x00, 0x00, 0x00, 0x00 },   // sp
    { 0x00, 0x00, 0x00, 0x2f, 0x00, 0x00 },   // !
    { 0x00, 0x00, 0x07, 0x00, 0x07, 0x00 },   // "
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    { 0x14, 0x14, 0x14, 0x14, 0x14, 0x14 }    // horiz lines
};

//======================================================
// 128X64I液晶底层驱动[8X16]字体库
// 设计者: powerint
// 描  述: [8X16]西文字符的字模数据 (纵向取模,字节倒序)
// !"#$%&'()*+,-./0123456789:;<=>?@ABCDEFGHIJKLMNOPQRSTUVWXYZ[\]^_`abcdefghijklmnopqrstuvwxyz{|}~
//======================================================
const byte F8X16[]=
{
	0x00,0x00,0x00,0x00,0x00,0x00,0x00,0x00,0x00,0x00,0x00,0x00,0x00,0x00,0x00,0x00,// 0
  0x00,0x00,0x00,0xF8,0x00,0x00,0x00,0x00,0x00,0x00,0x00,0x33,0x30,0x00,0x00,0x00,//!1
  0x00,0x10,0x0C,0x06,0x10,0x0C,0x06,0x00,0x00,0x00,0x00,0x00,0x00,0x00,0x00,0x00,//"2
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  0x00,0x06,0x01,0x01,0x02,0x02,0x04,0x04,0x00,0x00,0x00,0x00,0x00,0x00,0x00,0x00,//~94

};


const byte LIBLOGO96x40[] = {
 /*--  调入了一幅图像：C:\Users\Administrator\Desktop\OLED@5110\lanz.bmp  --*/
/*--  宽度x高度=96x40  --*/
0x00,0x00,0x00,0x00,0x00,0x00,0x80,0xC0,0xC0,0x60,0x20,0x50,0x20,0x30,0x2C,0x3C,
0x3C,0x3C,0x3C,0x7C,0x7C,0x7C,0xF8,0xF8,0xF0,0xF0,0xE0,0xC0,0xC0,0x80,0x00,0x00,
0x00,0x00,0x00,0x00,0x00,0x50,0xD8,0x58,0x98,0xD0,0x10,0xD0,0xD0,0x50,0x58,0x58,
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0x01,0x00,0x00,0x01,0x03,0x03,0x03,0x01,0x00,0x00,0x00,0x00,0x00,0x00,0x00,0x00

};
void LCD_WrDat(byte data) //数据
{
    byte i=8;
    //LCD_CS=0;;
//    GPIOA_PDOR |=  GPIO_PDOR_PDO(GPIO_PIN(12));;;;
    OLED_DC=1;
    asm("nop");
//    GPIOA_PDOR &= ~GPIO_PDOR_PDO(GPIO_PIN(15));;;;
    OLED_D0=0;
    asm("nop");
  while(i--)
  {
    if(data&0x80){OLED_D1=1;}
    else{OLED_D1=0;}
    OLED_D0=1;
    asm("nop");;;;
		//asm("nop");
    OLED_D0=0;
    data<<=1;
  }
	//LCD_CS=1;
}


void LCD_WrCmd(byte cmd)//命令
{
  byte i=8;

  //LCD_CS=0;;
//  GPIOA_PDOR &= ~GPIO_PDOR_PDO(GPIO_PIN(12));;;;;
//  GPIOA_PDOR &= ~GPIO_PDOR_PDO(GPIO_PIN(15));;;;;
  OLED_DC=0;
  OLED_D0=0;
  //asm("nop");
  while(i--)
  {
    if(cmd&0x80){OLED_D1=1;}
    else{OLED_D1=0;}
    OLED_D0=1;

    asm("nop");;;; //4
		//asm("nop");
    OLED_D0=0;
    cmd<<=1;;;;;
  }
	//LCD_CS=1;
}
void LCD_Set_Pos(byte x, byte y) //有关ＯＬＥＤ液晶显示地址的定位函数：
{
  LCD_WrCmd(0xb0+y); //设置页地址 每页8行
  LCD_WrCmd(((x&0xf0)>>4)|0x10); //设置行高四位地址
  LCD_WrCmd((x&0x0f)|0x00);  //设置行低四位地址
}


void LCD_Fill(byte bmp_data)
{
	byte y,x;

	for(y=0;y<8;y++)
	{
		LCD_WrCmd(0xb0+y);  //设置每页X起始地址均从头开始
		LCD_WrCmd(0x01); //低四位行地址设置
		LCD_WrCmd(0x10); //高四位行地址设置
		for(x=0;x<X_WIDTH;x++)    //X_WIDTH=128,写数据将每一个点均设置为0x00
			LCD_WrDat(bmp_data);
	}
}

void LCD_CLS(void)  //清屏
{
	byte y,x;
	for(y=0;y<8;y++)
	{
		LCD_WrCmd(0xb0+y);
		LCD_WrCmd(0x01);
		LCD_WrCmd(0x10);
		for(x=0;x<X_WIDTH;x++)
			LCD_WrDat(0);
	}
}
void LCD_DLY_ms(word ms)
{
  word a;
  while(ms)
  {
    a=13350;
    while(a--);
    ms--;
  }
  return;
}
void OLED_Init(void)
{

          gpio_init (PTA13, GPO,1);
          gpio_init (PTA14, GPO,1);
          gpio_init (PTA15, GPO,1);
          gpio_init (PTA16, GPO,1);


	//LCD_CS=1;	//预制SLK和SS为高电平

	OLED_RST=0;
	LCD_DLY_ms(50);
	OLED_RST=1;
  LCD_WrCmd(0xae);//--turn off oled panel 关显示
  LCD_WrCmd(0x00);//---set low column address 设置低列地址
  LCD_WrCmd(0x10);//---set high column address 设置高列地址
  LCD_WrCmd(0x40);//--set start line address 开始行 Set Mapping RAM Display Start Line (0x00~0x3F)
  LCD_WrCmd(0x81);//--set contrast control register 设置与控制寄存器
  LCD_WrCmd(0xcf); // Set SEG Output Current Brightness 设置输出电流亮度
  LCD_WrCmd(0xa0);//--Set SEG/Column Mapping     0xa0左右反置 0xa1正常
  LCD_WrCmd(0xc0);//Set COM/Row Scan Direction   0xc0上下反置 0xc8正常
  LCD_WrCmd(0xa6);//--set normal display 设置正常显示
  LCD_WrCmd(0xa8);//--set multiplex ratio(1 to 64) 设置多路复用率
  LCD_WrCmd(0x3f);//--1/64 duty
  LCD_WrCmd(0xd3);//-set display offset	Shift Mapping RAM Counter (0x00~0x3F)
  LCD_WrCmd(0x00);//-not offset
  LCD_WrCmd(0xd5);//--set display clock divide ratio/oscillator frequency 时钟频率
  LCD_WrCmd(0x80);//--set divide ratio, Set Clock as 100 Frames/Sec
  LCD_WrCmd(0xd9);//--set pre-charge period  充电周期
  LCD_WrCmd(0xf1);//Set Pre-Charge as 15 Clocks & Discharge as 1 Clock
  LCD_WrCmd(0xda);//--set com pins hardware configuration
  LCD_WrCmd(0x12);
  LCD_WrCmd(0xdb);//--set vcomh
  LCD_WrCmd(0x40);//Set VCOM Deselect Level
  LCD_WrCmd(0x20);//-Set Page Addressing Mode (0x00/0x01/0x02)
  LCD_WrCmd(0x02);//
  LCD_WrCmd(0x8d);//--set Charge Pump enable/disable
  LCD_WrCmd(0x14);//--set(0x10) disable
  LCD_WrCmd(0xa4);// Disable Entire Display On (0xa4正常显示/0xa5整体点亮)
  LCD_WrCmd(0xa6);// Disable Inverse Display On (0xa6正常显示/a7反色显示)
  LCD_WrCmd(0xaf);//--turn on oled panel 开显示
  LCD_Fill(0x00);  //初始清屏
  LCD_Set_Pos(0,0);

}

//==============================================================
//函数名： void LCD_PutPixel(byte x,byte y)
//功能描述：绘制一个点（x,y）
//参数：真实坐标值(x,y),x的范围0～127，y的范围0～64
//返回：无
//==============================================================
void LCD_PutPixel(byte x,byte y)
{
	byte data1;  //data1当前点的数据

                               //设置每页x起始地址均从头开始
        data1 = 0x01<<(y%8); //确定每页中点的位置
        LCD_WrCmd(0xb0+(y>>3));  //在第几页显示
        LCD_WrCmd(((x&0xf0)>>4)|0x10);
        LCD_WrCmd((x&0x0f)|0x00);
        LCD_WrDat(data1); //画y=??
}
//==============================================================
//函数名： void LCD_Rectangle(byte x1,byte y1,
//                   byte x2,byte y2,byte color,byte gif)
//功能描述：绘制一个实心矩形
//参数：左上角坐标（x1,y1）,右下角坐标（x2，y2）
//      其中x1、x2的范围0～127，y1，y2的范围0～63，即真实坐标值
//返回：无
//==============================================================
void LCD_Rectangle(byte x1,byte y1,byte x2,byte y2,byte gif)
{
	byte n,m;

        LCD_Set_Pos(x1,y1>>3);
          for(n=x1;n<=x2;n++)
          {
                  LCD_WrDat(0x01<<(y1%8));
                  if(gif == 1) 	LCD_DLY_ms(50);
          }


	LCD_Set_Pos(x1,y2>>3);
        for(n=x1;n<=x2;n++)
        {
                LCD_WrDat(0x01<<(y2%8));

                if(gif == 1) 	LCD_DLY_ms(5);
        }
     /*    LCD_Set_Pos(x1,y1>>3);
          LCD_WrDat(0xff);
         LCD_Set_Pos(x1,y2>>3);
          LCD_WrDat(0x07);
         LCD_Set_Pos(x2,y1>>3);
          LCD_WrDat(0xff);
         LCD_Set_Pos(x2,y2>>3);
          LCD_WrDat(0x07); */

}
//==============================================================
//函数名：LCD_P6x8Str(byte x,byte y,byte *p)
//功能描述：写入一组标准ASCII字符串
//参数：显示的位置（x,y），y为页范围0～7，要显示的字符串
//返回：无
//==============================================================
void LCD_P6x8Str(byte x,byte y,byte ch[]) //指定位置显示6*8字符
{
  byte c=0,i=0,j=0;
  while (ch[j]!='\0')
  {
    c =ch[j]-32;
    if(x>126){x=0;y++;}   //0~128中6的最大倍数是126，如果大于126，最后一个字符显示不出来(应为121)
    LCD_Set_Pos(x,y);
    for(i=0;i<6;i++)
      LCD_WrDat(F6x8[c][i]);  //低四位在上，高四位在下    按列显示
    x+=6;
    j++;
  }
}
/********************************************************/
//   写入6*8字符串（个位和多位显示）
/********************************************************/
void LCD_single_P6x8Str(byte x,byte y,byte ch[])
{
  byte c=0,i=0,j=0;
  for(;ch[j]!='\0';j++)
  {
      if(ch[1]=='\0')
     {
        c =ch[j]-32;
        if(x>126){x=0;y++;}   //0~128中6的最大倍数是126，如果大于126，最后一个字符显示不出来(应为121)
        LCD_Set_Pos(x,y);
        for(i=0;i<6;i++)
          LCD_WrDat(F6x8[c][i]);  //低四位在上，高四位在下    按列显示
        LCD_Set_Pos(x+6,y);
        for(i=0;i<6;i++)
          LCD_WrDat(F6x8[0][i]);
        LCD_Set_Pos(x+6+6,y);
        for(i=0;i<6;i++)
          LCD_WrDat(F6x8[0][i]);
        x+=6;

     }
     else
     {
       c =ch[j]-32;
       if(x>126){x=0;y++;}
       LCD_Set_Pos(x,y);
       for(i=0;i<6;i++)
        LCD_WrDat(F6x8[c][i]);
       x+=6;
     }
  }
}
//==============================================================
//函数名：LCD_P8x16Str(byte x,byte y,byte *p)
//功能描述：写入一组标准ASCII字符串
//参数：显示的位置（x,y），y为页范围0～7，要显示的字符串
//返回：无
//==============================================================
void LCD_P8x16Str(byte x,byte y,byte ch[])
{
  byte c=0,i=0,j=0;
  while (ch[j]!='\0')
  {
    c =ch[j]-32;
    if(x>120){x=0;y++;}
    LCD_Set_Pos(x,y);
  	for(i=0;i<8;i++)
         LCD_WrDat(F8X16[c*16+i]);
  	LCD_Set_Pos(x,y+1);
  	for(i=0;i<8;i++)
  	  LCD_WrDat(F8X16[c*16+i+8]);
  	x+=8;
  	j++;
  }
}
//写入8*16字符串（不同字符位数显示）
void LCD_single_P8x16Str(byte x,byte y,byte ch[])
{
  byte c=0,i=0,j=0,n;
 for(;ch[j]!='\0';j++)
  {
      if(ch[j+1]=='\0')
      {
        c =ch[j]-32;
        if(x>120){x=0;y++;}
        LCD_Set_Pos(x,y);
          for(i=0;i<8;i++)
           LCD_WrDat(F8X16[c*16+i]);
        LCD_Set_Pos(x,y+1);
          for(i=0;i<8;i++)
           LCD_WrDat(F8X16[c*16+i+8]);
        for(n=0;n<7-j;n++)
        {
          x=x+8;
          LCD_Set_Pos(x,y);
          for(i=0;i<8;i++)
           LCD_WrDat(0);
          LCD_Set_Pos(x,y+1);
          for(i=0;i<8;i++)
           LCD_WrDat(0);
        }
       }
        else
        {
           c =ch[j]-32;
           if(x>120){x=0;y++;}
           LCD_Set_Pos(x,y);
              for(i=0;i<8;i++)
               LCD_WrDat(F8X16[c*16+i]);
           LCD_Set_Pos(x,y+1);
              for(i=0;i<8;i++)
               LCD_WrDat(F8X16[c*16+i+8]);
           x+=8;
        }
  }

}

//输出汉字和字符混合字符串
void LCD_Print(byte x, byte y, byte ch[])
{
	byte ch2[3];
	byte ii=0;
	while(ch[ii] != '\0')
	{
		if(ch[ii] > 127)
		{
			ch2[0] = ch[ii];
	 		ch2[1] = ch[ii + 1];
			ch2[2] = '\0';			//汉字为两个字节
			LCD_P14x16Str(x , y, ch2);	//显示汉字
			x += 14;
			ii += 2;
		}
		else
		{
			ch2[0] = ch[ii];
			ch2[1] = '\0';			//字母占一个字节
			LCD_P8x16Str(x , y , ch2);	//显示字母
			x += 8;
			ii+= 1;
		}
	}
}

//==============================================================
//函数名： void Draw_BMP(byte x,byte y)
//功能描述：显示BMP图片128×64
//参数：起始点坐标(x,y),x的范围0～127，y为页的范围0～7
//返回：无
//==============================================================
void Draw_BMP(byte x0,byte y0,byte x1,byte y1,byte bmp[])
{
  word ii=0;
  byte x,y;

  if(y1%8==0) y=y1/8;
  else y=y1/8+1;
	for(y=y0;y<=y1;y++)
	{
		LCD_Set_Pos(x0,y);
    for(x=x0;x<x1;x++)
	    {
	    	LCD_WrDat(bmp[ii++]);
	    }
	}
}

void Draw_LibLogo(void)
{
  word ii=0;
  byte x,y;

  for(y=2;y<7;y++)
	{
            LCD_Set_Pos(0,y);
            for(x=16;x<112;x++)
            {
                LCD_WrDat(LIBLOGO96x40[ii++]);
            }
        }
}

uint8 LCD_GRAM[128][8];
//更新显存LCD
void LCD_Refresh_Gram(void)
{
	uint8 i,n;
	for(i=0;i<8;i++)
	{
		LCD_WR_Byte (0xb0+i,0);
		LCD_WR_Byte (0x00,0);
		LCD_WR_Byte (0x10,0);
		for(n=0;n<128;n++)LCD_WR_Byte(LCD_GRAM[n][i],1);
	}
}

//写一个字节
//0命令 1数字
void LCD_WR_Byte(uint8 dat,uint8 cmd)
{
	uint8 i;
	OLED_DC=cmd; //D′?üá?
//	OLED_CS=0;
	for(i=0;i<8;i++)
	{
		OLED_D0=0;
		if(dat&0x80)OLED_D1=1;
		else OLED_D1=0;
		OLED_D0=1;
		dat<<=1;
	}
//	OLED_CS=1;
	OLED_DC=1;
}


//画点
void LCD_DrawPoint(uint8 x,uint8 y,uint8 t)
{
	uint8   pos,bx,temp=0;
	if(x>127||y>63)return;//3?3?·??§á?.
	pos=y/8;   //页倒置  7-
	bx=y%8;
	temp=1<<bx;  //点倒置  7-
	if(t)LCD_GRAM[x][pos]|=temp;
	else LCD_GRAM[x][pos]&=~temp;
}

